/include/ "system-conf.dtsi"
/ {
};

/* Let U-Boot DM bind the QSPI NOR (env, OTP MAC read) */
&flash0 {
	#address-cells = <1>;
	#size-cells = <1>;
	compatible = "jedec,spi-nor";
	reg = <0x0>;
	spi-tx-bus-width = <1>;
	spi-rx-bus-width = <4>;
	spi-max-frequency = <100000000>;
};
